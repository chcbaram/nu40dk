## firmware/nu40dk-fw/boards/nucode/nu40dk/Kconfig.defconfig
```kconfig
if BOARD_NU40DK

config HW_STACK_PROTECTION
	default ARCH_HAS_STACK_PROTECTION

endif # BOARD_NU40DK
```

## firmware/nu40dk-fw/boards/nucode/nu40dk/board.yml
```yaml
board:
  name: nu40dk
  full_name: NU40DK
  vendor: nucode
  socs:
    - name: nrf52840
```
